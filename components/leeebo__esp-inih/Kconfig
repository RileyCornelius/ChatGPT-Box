## components/leeebo__esp-inih/Kconfig
```kconfig
menu "ESP INIH"
    config INI_HANDLER_LINENO
        bool "call the handler with the line number of the line just read"
        default n
    config INI_ALLOW_MULTILINE
        bool "allow multi-line value parsing"
        default y
    config INI_ALLOW_BOM
        bool "allow a UTF-8 BOM sequence (0xEF 0xBB 0xBF) at the start of the file"
        default y
    config INI_START_COMMENT_PREFIXES
        string "Chars that begin a start-of-line comment"
        default ";#"
    config INI_ALLOW_INLINE_COMMENTS
        bool "allow inline comments"
        default y
    config INI_INLINE_COMMENT_PREFIXES
        string "inline comments prefix"
        default ";"
    config INI_STOP_ON_FIRST_ERROR
        bool "stop parsing on first error"
        default n
    config INI_CALL_HANDLER_ON_NEW_SECTION
        bool "call the handler at the start of each new section (with name and value NULL)"
        default n
    config INI_ALLOW_NO_VALUE
        bool "allow a name without a value (no '=' or ':' on the line), else treat as an error"
        default n
    config INI_USE_STACK
        bool "use stack for line buffer, else use heap"
        default n
    config INI_MAX_LINE
        int "maximum line length for any line in INI file (stack or heap)"
        default 200
    config INI_ALLOW_REALLOC
        bool "allow heap line buffer to grow via realloc()"
        depends on !INI_USE_STACK
        default y
    config INI_INITIAL_ALLOC
        int "initial size in bytes for heap line buffer"
        depends on !INI_USE_STACK
        default 200
    config INI_CUSTOM_ALLOCATOR
        bool "using custom ini_malloc, ini_free, and ini_realloc"
        depends on !INI_USE_STACK
        default n
endmenu
```

## components/leeebo__tinyusb_src/Kconfig
```kconfig
menu "TinyUSB soucre"

    config USING_SYNOPSYS_DWC2_DRIVER
        bool "Using synopsys dwc2 driver, otherwise using esp32sx dcd driver"
        default n
        help
            "For esp32sx, user can choose esp32sx dcd driver or common synopsys dwc2 driver"

endmenu
```

## main/Kconfig.projbuild
```kconfig
menu "Example Configuration"

    config ESP_WIFI_SSID
        string "WiFi SSID"
        default ""
        help
            SSID (network name) for the example to connect to.
    config ESP_WIFI_PASSWORD
        string "WiFi Password"
        default ""
        help
            WiFi password (WPA or WPA2) for the example to use.
    config OPENAI_API_KEY
        string "OpenAI Key"
        default ""
        help
            OpenAI api key for the example to use.
    config OPENAI_MODEL
        string "OpenAI model"
        default "gpt-3.5-turbo"
        help
            OpenAI model eg gpt-3.5-turbo (chatgpt).

    config VOICE_ID
        string "Speaker Id"
        default "kaolam_diantai"
        help
            speaker id from https://czyt.tech/post/a-free-tts-api/?from_wecom=1
    config VOLUME_LEVEL
        int "volume level"
        default "90"
        range 1 100
        help
            speaker volume
    config MAX_TOKEN
        int "Chat GPT Response Token"
        default 500
        range 1 2048
        help
            Chat GPT response token between 1 - 2048.            
    config ESP_MAXIMUM_RETRY
        int "Maximum retry"
        default 5
        help
            Set the Maximum retry to avoid station reconnecting to the AP unlimited when the AP is really inexistent.

endmenu
```
